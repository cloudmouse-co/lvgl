#include "LEDManager.h"
#include "EncoderManager.h"
#include "LGFX_ILI9488.h"
#include <lvgl.h>
#include <Arduino.h>

#define BUZZER_PIN 14
#define VIBRO_PIN 9

Adafruit_NeoPixel ledStrip(NUM_LEDS, DATA_PIN, NEO_GRB + NEO_KHZ800);
LEDManager ledManager(ledStrip);
EncoderManager encoderManager;

LGFX_ILI9488 display;
LGFX_Sprite sprite(&display);

const uint16_t pixelData[12][12] = {
  // Riga 0 (sfondo: tutti pixel trasparenti diventano bianco = 0xFFFF)
  { 0xFFFF, 0xFFFF, 0xFFFF, 0xFFFF, 0xFFFF, 0xFFFF, 0xFFFF, 0xFFFF, 0xFFFF, 0xFFFF, 0xFFFF, 0xFFFF },
  // Riga 1
  { 0xFFFF, 0xFFFF, 0x0000, 0xFFFF, 0xFFFF, 0xFFFF, 0xFFFF, 0xFFFF, 0xFFFF, 0x0000, 0xFFFF, 0xFFFF },
  // Riga 2
  { 0xFFFF, 0xFD99, 0x0000, 0x9CF3, 0xFFFF, 0xFFFF, 0xFFFF, 0xFFFF, 0xCCB9, 0x0000, 0xFD99, 0xFFFF },
  // Riga 3
  { 0x0000, 0xFE7B, 0xFE7B, 0x0000, 0x0000, 0xFFFF, 0xFFFF, 0x0000, 0x0000, 0xFE7B, 0xFE7B, 0x0000 },
  // Riga 4
  { 0x0000, 0xFE7B, 0xFE7B, 0xFD99, 0xCCB9, 0xCCB9, 0x9CF3, 0x9CF3, 0xFD99, 0xFE7B, 0xFE7B, 0x0000 },
  // Riga 5
  { 0x0000, 0xFE7B, 0xFE7B, 0xFD99, 0xCCB9, 0xCCB9, 0x9CF3, 0x9CF3, 0xFD99, 0xFE7B, 0xFE7B, 0x0000 },
  // Riga 6
  { 0x0000, 0xFE7B, 0xFE7B, 0x0000, 0x0000, 0xFFFF, 0xFFFF, 0x0000, 0x0000, 0xFE7B, 0xFE7B, 0x0000 },
  // Riga 7
  { 0xFFFF, 0xFD99, 0x0000, 0x9CF3, 0xFFFF, 0xFFFF, 0xFFFF, 0xFFFF, 0xCCB9, 0x0000, 0xFD99, 0xFFFF },
  // Riga 8
  { 0xFFFF, 0xFFFF, 0x0000, 0xFFFF, 0xFFFF, 0xFFFF, 0xFFFF, 0xFFFF, 0xFFFF, 0x0000, 0xFFFF, 0xFFFF },
  // Riga 9
  { 0xFFFF, 0xFFFF, 0xFFFF, 0xFFFF, 0xFFFF, 0xFFFF, 0xFFFF, 0xFFFF, 0xFFFF, 0xFFFF, 0xFFFF, 0xFFFF },
  // Riga 10
  { 0xFFFF, 0xFFFF, 0xFFFF, 0xFFFF, 0xFFFF, 0xFFFF, 0xFFFF, 0xFFFF, 0xFFFF, 0xFFFF, 0xFFFF, 0xFFFF },
  // Riga 11
  { 0xFFFF, 0xFFFF, 0xFFFF, 0xFFFF, 0xFFFF, 0xFFFF, 0xFFFF, 0xFFFF, 0xFFFF, 0xFFFF, 0xFFFF, 0xFFFF }
};

const uint32_t pixelData1[23][23] = {
  { 0xFFFFFF, 0xFFFFFF, 0xFFFFFF, 0xFFFFFF, 0xFFFFFF, 0xFFFFFF, 0xFFFFFF, 0xFFFFFF, 0xFFFFFF, 0xFFFFFF, 0xFFFFFF, 0xFFFFFF, 0xFFFFFF, 0xFFFFFF, 0xFFFFFF, 0xFFFFFF, 0xFFFFFF, 0xFFFFFF, 0xFFFFFF, 0xFFFFFF, 0xFFFFFF, 0xFFFFFF, 0xFFFFFF },
  { 0xFFFFFF, 0xFFFFFF, 0xFFFFFF, 0xFFFFFF, 0xFFFFFF, 0xFFFFFF, 0xFFFFFF, 0xFFFFFF, 0xFFFFFF, 0xFFFFFF, 0xFFFFFF, 0xFFFFFF, 0xFFFFFF, 0xFFFFFF, 0xFFFFFF, 0xFFFFFF, 0xFFFFFF, 0xFFFFFF, 0xFFFFFF, 0xFFFFFF, 0xFFFFFF, 0xFFFFFF, 0xFFFFFF },
  { 0xFFFFFF, 0xFFFFFF, 0xFFFFFF, 0x070000, 0x070000, 0xFFFFFF, 0xFFFFFF, 0xFFFFFF, 0xFFFFFF, 0xFFFFFF, 0xFFFFFF, 0xFFFFFF, 0xFFFFFF, 0xFFFFFF, 0xFFFFFF, 0xFFFFFF, 0xFFFFFF, 0xFFFFFF, 0x070000, 0x070000, 0xFFFFFF, 0xFFFFFF, 0xFFFFFF },
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  { 0xFFFFFF, 0xFFFFFF, 0xFFFFFF, 0xFFFFFF, 0xFFFFFF, 0xFFFFFF, 0xFFFFFF, 0xFFFFFF, 0xFFFFFF, 0xFFFFFF, 0xFFFFFF, 0xFFFFFF, 0xFFFFFF, 0xFFFFFF, 0xFFFFFF, 0xFFFFFF, 0xFFFFFF, 0xFFFFFF, 0xFFFFFF, 0xFFFFFF, 0xFFFFFF, 0xFFFFFF, 0xFFFFFF }
};

const unsigned int screenWidth = 480;
const unsigned int screenHeight = 320;
const unsigned int lvBufferSize = screenWidth * screenHeight / 10 * (LV_COLOR_DEPTH / 8);
uint8_t lvBuffer[lvBufferSize];


static void event_handler(lv_event_t * e)
{
    lv_event_code_t code = lv_event_get_code(e);

    if(code == LV_EVENT_CLICKED) {
        LV_LOG_USER("Clicked");
    }
    else if(code == LV_EVENT_VALUE_CHANGED) {
        LV_LOG_USER("Toggled");
    }
}

void lv_example_button_1(void)
{
    lv_obj_t * label;

    lv_obj_t * btn1 = lv_button_create(lv_screen_active());
    lv_obj_add_event_cb(btn1, event_handler, LV_EVENT_ALL, NULL);
    lv_obj_align(btn1, LV_ALIGN_CENTER, 0, -40);
    lv_obj_remove_flag(btn1, LV_OBJ_FLAG_PRESS_LOCK);

    label = lv_label_create(btn1);
    lv_label_set_text(label, "Button");
    lv_obj_center(label);

    lv_obj_t * btn2 = lv_button_create(lv_screen_active());
    lv_obj_add_event_cb(btn2, event_handler, LV_EVENT_ALL, NULL);
    lv_obj_align(btn2, LV_ALIGN_CENTER, 0, 40);
    lv_obj_add_flag(btn2, LV_OBJ_FLAG_CHECKABLE);
    lv_obj_set_height(btn2, LV_SIZE_CONTENT);

    label = lv_label_create(btn2);
    lv_label_set_text(label, "Toggle");
    lv_obj_center(label);

}

void drawMascotte() {
}

static uint32_t my_tick(void)
{
    return millis();
}

 lv_obj_t *label;

void setup() {
  Serial.begin(115200);

  delay(1000);

  Serial.println("");
  Serial.println("serial ok");

  ledManager.init();

  ledManager.startAnimationTask();


  pinMode(BUZZER_PIN, OUTPUT);
  pinMode(VIBRO_PIN, OUTPUT);

  //digitalWrite(VIBRO_PIN, HIGH);
  //delay(1000);
  //digitalWrite(VIBRO_PIN, LOW);

/*
  buzzWithPWM(740, 75, 20);
  buzzWithPWM(120, 75, 20);
  buzzWithPWM(270, 75, 20);
*/
  display.init();
  // display.setMyRotation(3);

  //display.fillScreen(TFT_RED);

  // TEST
  //display.setRotation(1);  // Se vuoi, ruota lo schermo

  // Inizializza LVGL
  lv_init();

  lv_tick_set_cb(my_tick);

  static auto *lvDisplay = lv_display_create(screenWidth, screenHeight);
  //lv_display_set_color_format(lvDisplay, LV_COLOR_FORMAT_RGB565);
  lv_display_set_color_format(lvDisplay, LV_COLOR_FORMAT_RGB565);
  lv_display_set_flush_cb(lvDisplay, [](lv_display_t* lv_disp, const lv_area_t* area, unsigned char* data) {
          uint32_t w = lv_area_get_width(area);
          uint32_t h = lv_area_get_height(area);
          lv_draw_sw_rgb565_swap(data, w*h);
          display.pushImage(area->x1, area->y1, w, h, (uint16_t*)data);
          lv_display_flush_ready(lv_disp);
      });
  lv_display_set_buffers(lvDisplay, lvBuffer, nullptr, lvBufferSize, LV_DISPLAY_RENDER_MODE_PARTIAL);



  label = lv_label_create( lv_screen_active() );
  lv_label_set_text( label, "Hello Arduino, I'm LVGL!" );
  lv_obj_align( label, LV_ALIGN_CENTER, 0, 0 );

  lv_example_button_1();

// FINE TEST

  if (psramFound()) {
    Serial.println("PSRAM rilevata e pronta!");
  } else {
    Serial.println("PSRAM non disponibile!");
  }

/*
  display.fillScreen(TFT_BLUE);
  sprite.setPsram(true);
  sprite.setColorDepth(16);
  sprite.createSprite(480, 320);
  sprite.fillScreen(TFT_WHITE);
  sprite.setTextColor(TFT_BLACK);
  sprite.setTextSize(3.5);
  sprite.setCursor(256, 126);

  int startX = 50;  // Offset per centrare l'immagine
  int startY = 50;
  int pixelSize = 8;  // Dimensione dei pixel

  // Disegna la griglia di pixel
  for (int y = 0; y < 23; y++) {
    for (int x = 0; x < 23; x++) {
      sprite.fillRect(startX + x * pixelSize, startY + y * pixelSize, pixelSize, pixelSize, pixelData1[y][x]);
    }
  }
  display.fillScreen(TFT_GREEN);
  sprite.print("IT WORKS!");
  sprite.pushSprite(0, 0);
  */
}

void loop() {
  int encoderMovement = encoderManager.getMovement();
  lv_timer_handler(); // gestisce i timer, gli eventi, ecc.

  //delay(5);

  if (encoderMovement > 0) {
    lv_label_set_text(label, "Clockwise");
    digitalWrite(VIBRO_PIN, HIGH);
    delay(1000);
    digitalWrite(VIBRO_PIN, LOW);

    // buzzWithPWM(740, 75, 20);
    // buzzWithPWM(120, 75, 20);
    // buzzWithPWM(270, 75, 20);
    /*
    delay(200);
    sprite.fillScreen(TFT_WHITE);
    sprite.setCursor(100, 100);
    sprite.print("CLOCKWISE");
    sprite.pushSprite(0, 0);
    */
    // ledManager.activate();
    // ledManager.setColor(rand() % 255, rand() % 255, rand() % 255);
  }

  if (encoderMovement < 0) {
    lv_label_set_text(label, "CCW");
    /*
    sprite.fillScreen(TFT_WHITE);
    sprite.setCursor(100, 100);
    sprite.print("COUNTERCLOCKWISE");
    sprite.pushSprite(0, 0);
    */
    // ledManager.activate();
    // ledManager.setColor(rand() % 255, rand() % 255, rand() % 255);
  }

  if (encoderManager.isButtonDown()) {
    lv_label_set_text(label, "PRESS");
    /*
    sprite.fillScreen(TFT_WHITE);
    sprite.setCursor(100, 100);
    sprite.print("BUTTON PRESSED");
    sprite.pushSprite(0, 0);
*/
    Serial.println("set loading state");
    // if (! ledManager.isLoading()) {
    //   ledManager.setLoadingState(true);
    //   delay(2000);
    // } else {
    //   ledManager.setLoadingState(false);
    //   ledManager.flashColor(255, 0, 0, 255, 1000);
    //   delay(500);
    // }
  }
}

void buzzWithPWM(int frequency, int duration, int dutyCycle) {
  int period = 1000000 / frequency;        // Periodo in microsecondi
  int pulse = (period * dutyCycle) / 100;  // Durata del ciclo on

  unsigned long startTime = millis();
  while (millis() - startTime < duration) {
    digitalWrite(BUZZER_PIN, HIGH);
    delayMicroseconds(pulse);  // Acceso per la parte on del ciclo
    digitalWrite(BUZZER_PIN, LOW);
    delayMicroseconds(period - pulse);  // Spento per il resto del ciclo
  }
}